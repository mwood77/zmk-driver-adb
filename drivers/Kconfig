## drivers/adb/Kconfig
```kconfig
menuconfig ADB_GPIO
    bool "ADB GPIO driver"
    depends on GPIO
    default y
    help
      A driver for monitoring the ADB pin via GPIO.

config ADB_GPIO_LOG_LEVEL
    int "Log level for ADB GPIO"
    depends on ADB_GPIO
    default 3
    range 0 4
```

## dts/bindings/adb-gpio.yaml
```yaml
description: ADB GPIO Driver
compatible: "custom,adb-gpio"
include: base.yaml

properties:
  gpios:
    type: phandle-array
    required: true
    description: GPIO pin used for ADB data
  debounce-period-ms:
    type: int
    required: false
    description: Optional debounce period for input changes, in milliseconds
```
